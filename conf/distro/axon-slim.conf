## conf/distro/axon-slim.conf
```bitbake
require conf/distro/poky.conf

DISTRO = "axon-slim"
DISTROOVERRIDES = "poky:axon-slim"

INIT_MANAGER:axon-slim = "erlinit"
```

## conf/distro/axon.conf
```bitbake
require ${COREBASE}/meta-poky/conf/distro/poky.conf

DISTRO = "axon"
DISTRO_NAME = "meta-erlang demo distro"
DISTRO_VERSION = "v1.0"

DISTROOVERRIDES = "poky:axon"

# systemd as the init system
INIT_MANAGER = "systemd"
DISTRO_FEATURES:append = " virtualization ipv6 seccomp"

# Default user account names and default admin group name
AXON_ADMIN_ACCOUNT = "axon"
AXON_ADMIN_GROUP = "sudo"
AXON_ADMIN_GROUP_OPTIONS ?= "NOPASSWD:"


# Select whether or not to generate the filesystem able to run in any aarch64
# platform. If AXON_GENERIC_ARM64_FILESYSTEM is "1", armv8a-crc DEFAULTTUNE
# will be used otherwise the one set by the MACHINE conf will be selected.
AXON_GENERIC_ARM64_FILESYSTEM ?= "1"
AXON_GENERIC_ARM64_DEFAULTTUNE ?= "armv8a-crc"

# Use generic DEFAULTTUNE if generic filestystem enabled otherwise preserve
# DEFAULTTUNE value.
DEFAULTTUNE:aarch64 := "\
${@ d.getVar('AXON_GENERIC_ARM64_DEFAULTTUNE', False) \
    if (bb.utils.to_boolean(d.getVar('AXON_GENERIC_ARM64_FILESYSTEM', \
                                     True), False)) \
    else d.getVar('DEFAULTTUNE', False)}"
```

## conf/layer.conf
```bitbake
# We have a conf and classes directory, append to BBPATH 
BBPATH .= ":${LAYERDIR}"

# We have a recipes directory, add to BBFILES
BBFILES += "${LAYERDIR}/recipes-*/*/*.bb ${LAYERDIR}/recipes-*/*/*.bbappend"

BBFILE_COLLECTIONS += "axon-layer"
BBFILE_PATTERN_axon-layer := "^${LAYERDIR}/"
BBFILE_PRIORITY_axon-layer = "8"

LAYERSERIES_COMPAT_axon-layer = "styhead walnascar"

LAYERDEPENDS_axon-layer = "erlang-layer"

BBFILES_DYNAMIC += "\
    cloud-services-layer:${LAYERDIR}/dynamic-layers/meta-cloud-services/recipes-*/*/*.bb \
    cloud-services-layer:${LAYERDIR}/dynamic-layers/meta-cloud-services/recipes-*/*/*.bbappend \
    "
```
